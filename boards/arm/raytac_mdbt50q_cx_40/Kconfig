## boards/arm/raytac_mdbt50q_cx_40/Kconfig
```kconfig
config BOARD_ENABLE_DCDC
    bool "Enable DCDC mode"
    select SOC_DCDC_NRF52X
    default y

config BOARD_ENABLE_DCDC_HV
    bool "Enable DCDC HV mode"
    select SOC_DCDC_NRF52X_HV
    default y
```

## boards/arm/raytac_mdbt50q_cx_40/Kconfig.board
```kconfig
config BOARD_RAYTAC_MDBT50Q_CX_40
    bool "Raytac MDBT50Q-CX-40"
    depends on SOC_NRF52840_QIAA
```

## boards/arm/raytac_mdbt50q_cx_40/Kconfig.defconfig
```kconfig
if BOARD_RAYTAC_MDBT50Q_CX_40

config BOARD
    default "Raytac MDBT50Q-CX-40"

if USB

config USB_NRFX
    default y

config USB_DEVICE_STACK
    default y

endif # USB

config BT_CTLR
    default BT

endif # BOARD_RAYTAC_MDBT50Q_CX_40
```
